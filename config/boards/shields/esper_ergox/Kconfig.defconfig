## config/boards/shields/esper_ergox/Kconfig.defconfig
```kconfig
if SHIELD_ESPER_ERGOX_DONGLE

config ZMK_KEYBOARD_NAME
	default "Esper ULP"
	
config ZMK_SPLIT_ROLE_CENTRAL
	default y

endif

if SHIELD_ESPER_ERGOX_LEFT || SHIELD_ESPER_ERGOX_RIGHT || SHIELD_ESPER_ERGOX_DONGLE

config ZMK_SPLIT
	default y

endif
```

## config/boards/shields/esper_ergox/Kconfig.shield
```kconfig
config SHIELD_ESPER_ERGOX_LEFT
	def_bool $(shields_list_contains,esper_ergox_left)

config SHIELD_ESPER_ERGOX_RIGHT
	def_bool $(shields_list_contains,esper_ergox_right)

config SHIELD_ESPER_ERGOX_DONGLE
	def_bool $(shields_list_contains,esper_ergox_dongle)
```
